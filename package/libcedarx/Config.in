## package/libcedarx/Config.in
```kconfig
config BR2_PACKAGE_LIBCEDARX
	bool "libcedarx"
	help
	Cedarx support for VLC.

	https://github.com/willswang/libcedarx
```

## package/sunxi-vlc/Config.in
```kconfig
config BR2_PACKAGE_SUNXI_VLC
	bool "sunxi-vlc"
	depends on (BR2_UCLIBC_VERSION_SNAPSHOT || BR2_UCLIBC_VERSION_NG || BR2_TOOLCHAIN_USES_GLIBC) # spawn.h
	depends on BR2_INSTALL_LIBSTDCPP
	depends on BR2_USE_WCHAR
	depends on BR2_TOOLCHAIN_HAS_THREADS
	depends on BR2_TOOLCHAIN_HEADERS_AT_LEAST_3_7
	select BR2_PACKAGE_LIBVORBIS if BR2_PACKAGE_OPUS
	help
	  Special edition for cedar support.

	  http://linux-sunxi.org/VLC

comment "vlc needs a uclibc snapshot, uclibc-ng or (e)glibc toolchain w/ C++, wchar, threads, headers >= 3.7"
	depends on !(BR2_UCLIBC_VERSION_SNAPSHOT || BR2_UCLIBC_VERSION_NG || BR2_TOOLCHAIN_USES_GLIBC) \
		|| !BR2_INSTALL_LIBSTDCPP || !BR2_USE_WCHAR \
		|| !BR2_TOOLCHAIN_HAS_THREADS || !BR2_TOOLCHAIN_HEADERS_AT_LEAST_3_7
```
